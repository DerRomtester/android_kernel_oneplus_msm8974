## drivers/cpuquiet/Kconfig
```kconfig
menu "CPUQUIET Framework"

config CPUQUIET_FRAMEWORK
	bool "Cpuquiet framework"
	help
	  Cpuquiet implements pluggable policies for forcing cpu cores into a
	  quiescent state. Appropriate policies will save power without hurting
	  performance.

if CPUQUIET_FRAMEWORK

choice
	prompt "Default CPUQuiet governor"
	help
	  This option sets which CPUQuiet governor shall be loaded at
	  startup. If in doubt, select 'balanced'
	  
config CPUQUIET_DEFAULT_GOV_LOAD_STATS
	bool "load_stats"
	select CPUQUIET_GOVERNOR_LOAD_STATS
	help
	  Use the CPUQuiet governor 'load_stats' as default
	  
endchoice

config CPUQUIET_GOVERNOR_LOAD_STATS
	bool "load_stats"
	help
	  Add the CPUQuiet governor 'load_stats'

endif
endmenu
```
